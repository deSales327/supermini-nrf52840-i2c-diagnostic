## bare/boards/arm/eyelash_nano/Kconfig.board
```kconfig
config BOARD_EYELASH_NANO
    bool "Eyelash Nano / SuperMini"
    depends on SOC_NRF52840_QIAA
```

## config/boards/shields/supermini_diag/Kconfig.shield
```kconfig
config SHIELD_SUPERMINI_DIAG
    def_bool $(shields_list_contains,supermini_diag)
```

## config/west.yml
```yaml
manifest:
  version: "0.13"

  remotes:
    - name: zmkfirmware
      url-base: https://github.com/zmkfirmware

  projects:
    - name: zephyr
      remote: zmkfirmware
      revision: v3.5.0+zmk-fixes
      import: west.yml

  self:
    path: config
```
