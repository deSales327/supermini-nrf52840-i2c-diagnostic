## CMakeLists.txt
```
if(CONFIG_SUPERMINI_I2C_DIAGNOSTIC)
  zephyr_library()
  zephyr_library_sources(src/diagnostic.c)
endif()
```

## Kconfig
```
config SUPERMINI_I2C_DIAGNOSTIC
	bool "SuperMini I2C diagnostic"
	default y
	help
	  Enable the I2C scanner thread for the SuperMini diagnostic firmware.
```

## west.yml
```
manifest:
  version: "0.13"

  remotes:
    - name: zephyrproject-rtos
      url-base: https://github.com/zephyrproject-rtos
    - name: eyelash
      url-base: https://github.com/a741725193

  projects:
    - name: zephyr
      remote: zephyrproject-rtos
      revision: v4.1.0
      import: west.yml
    - name: zmk-board-eyelash
      remote: eyelash
      revision: main

  self:
    path: .
```

## prj.conf
```kconfig
CONFIG_I2C=y
CONFIG_SERIAL=y
CONFIG_CONSOLE=y
CONFIG_UART_CONSOLE=y
CONFIG_USB_DEVICE_STACK=y
CONFIG_USB_CDC_ACM=y
CONFIG_UART_LINE_CTRL=y
CONFIG_PRINTK=y
CONFIG_MAIN_STACK_SIZE=2048
```

## app.overlay
```dts
/*
 * The eyelash_nano board definition already assigns:
 *   SDA -> P0.17
 *   SCL -> P0.20
 * and provides a USB CDC ACM console.
 */
&i2c0 {
	status = "okay";
};
```

## src/main.c
```c
/*
 * SuperMini nRF52840 I2C diagnostic
 *
 * SPDX-License-Identifier: MIT
 */

#include <zephyr/device.h>
#include <zephyr/drivers/i2c.h>
#include <zephyr/kernel.h>
#include <zephyr/sys/printk.h>

#define I2C_NODE DT_NODELABEL(i2c0)
#define SCAN_FIRST_ADDRESS 0x08
#define SCAN_LAST_ADDRESS  0x77
#define SCAN_INTERVAL_MS   5000

static const struct device *const i2c_dev = DEVICE_DT_GET(I2C_NODE);

static int probe_address(uint16_t address)
{
	/* A zero-byte write is the usual I2C address probe. */
	return i2c_write(i2c_dev, NULL, 0, address);
}

static void scan_bus(void)
{
	int found = 0;

	printk("\r\nI2C scan: bus=i2c0 SDA=P0.17 SCL=P0.20\r\n");
	printk("Checking 7-bit addresses 0x%02x..0x%02x ...\r\n",
	       SCAN_FIRST_ADDRESS, SCAN_LAST_ADDRESS);

	for (uint16_t address = SCAN_FIRST_ADDRESS;
	     address <= SCAN_LAST_ADDRESS;
	     address++) {
		int ret = probe_address(address);

		if (ret == 0) {
			printk("FOUND 0x%02x\r\n", address);
			found++;
		}
	}

	if (found == 0) {
		printk("No devices acknowledged.\r\n");
	} else {
		printk("Found %d device%s.\r\n", found, found == 1 ? "" : "s");
	}

	printk("A scan repeats every %d seconds.\r\n", SCAN_INTERVAL_MS / 1000);
}

int main(void)
{
	printk("\r\n========================================\r\n");
	printk("SuperMini nRF52840 I2C diagnostic\r\n");
	printk("Target: eyelash_nano / I2C0\r\n");
	printk("Expected pins: SDA=P0.17, SCL=P0.20\r\n");
	printk("========================================\r\n");

	if (!device_is_ready(i2c_dev)) {
		printk("ERROR: i2c0 is not ready.\r\n");
		return 0;
	}

	printk("i2c0 is ready.\r\n");

	while (true) {
		scan_bus();
		k_msleep(SCAN_INTERVAL_MS);
	}

	return 0;
}
```

## src/diagnostic.c
```c
/*
 * SuperMini nRF52840 USB diagnostic for ZMK
 *
 * SPDX-License-Identifier: MIT
 */

#include <zephyr/kernel.h>
#include <zephyr/sys/printk.h>

#define USB_STARTUP_DELAY_MS 3000
#define HEARTBEAT_INTERVAL_MS 1000

static void diagnostic_thread(void *unused_a, void *unused_b, void *unused_c)
{
    ARG_UNUSED(unused_a);
    ARG_UNUSED(unused_b);
    ARG_UNUSED(unused_c);

    k_msleep(USB_STARTUP_DELAY_MS);

    printk("\r\n========================================\r\n");
    printk("SuperMini nRF52840 USB diagnostic\r\n");
    printk("USB CDC started; I2C scan temporarily disabled\r\n");
    printk("========================================\r\n");

    while (true) {
        printk("USB CDC alive\r\n");
        k_msleep(HEARTBEAT_INTERVAL_MS);
    }
}

K_THREAD_DEFINE(supermini_usb_diagnostic, 1024,
                diagnostic_thread, NULL, NULL, NULL, 5, 0, 0);
```
